# nrf52840 register map
Vendor: Nordic Semiconductor; Series: nrf52; File version: 1
nRF52840 reference description for radio MCU with ARM 32-bit Cortex-M4 Microcontroller
CPU: CM4 r0p1, little endian, MPU, FPU, 3 interrupt priority bits, 112 interrupts
Registers are 32-bit, rw-once, reset 0x0 unless marked. A register's access mark holds for its fields unless they carry their own. Offsets are from the block's base; lines under a group give offsets from that group; [hi:lo] are bit positions; {n}, {i} and the like mark numbered series; 'fields as' and 'values as' point back to an identical list; <NAME> marks a mode.

## Memory map
0x40000000 APPROTECT size 0x1000 — Access Port Protection
0x40014000 SWI0 size 0x1000 — Software interrupt 0
0x40015000 SWI1 size 0x1000 — Software interrupt 1

## Interrupts
20 EGU0_SWI0 (SWI0)
21 EGU1_SWI1 (SWI1)

## Further device data
MaxInterrupts=112

## APPROTECT — Access Port Protection
Base 0x40000000
0x550 FORCEPROTECT reset 0xFFFFFFFF — Software force enable APPROTECT mechanism until next reset.
  [7:0] FORCEPROTECT — Write 0x0 to force enable APPROTECT mechanism
    on write: 0=Force (Software force enable APPROTECT mechanism)
0x558 DISABLE rw — Software disable APPROTECT mechanism
  [7:0] DISABLE
    90=SwDisable (Software disable APPROTECT mechanism)

## SWI0 — Software interrupt 0
Base 0x40014000; alternate view of EGU0
Same registers: SWI1 0x40015000 (alternate view of EGU1)

## Licence text in the file
Copyright (c) 2010 - 2026, Nordic Semiconductor ASA All rights reserved. SPDX-License-Identifier: BSD-3-Clause Redistribution and use in source and binary forms, with or without modification, are permitted provided that the following conditions are met: 1. Redistributions of source code must retain the above copyright notice, this list of conditions and the following disclaimer. 2. Redistributions in binary form must reproduce the above copyright notice, this list of conditions and the following disclaimer in the documentation and/or other materials provided with the distribution. 3. Neither the name of Nordic Semiconductor ASA nor the names of its contributors may be used to endorse or promote products derived from this software without specific prior written permission. THIS SOFTWARE IS PROVIDED BY THE COPYRIGHT HOLDERS AND CONTRIBUTORS "AS IS" AND ANY EXPRESS OR IMPLIED WARRANTIES, INCLUDING, BUT NOT LIMITED TO, THE IMPLIED WARRANTIES OF MERCHANTABILITY, AND FITNESS FOR A PARTICULAR PURPOSE ARE DISCLAIMED. IN NO EVENT SHALL NORDIC SEMICONDUCTOR ASA OR CONTRIBUTORS BE LIABLE FOR ANY DIRECT, INDIRECT, INCIDENTAL, SPECIAL, EXEMPLARY, OR CONSEQUENTIAL DAMAGES (INCLUDING, BUT NOT LIMITED TO, PROCUREMENT OF SUBSTITUTE GOODS OR SERVICES; LOSS OF USE, DATA, OR PROFITS; OR BUSINESS INTERRUPTION) HOWEVER CAUSED AND ON ANY THEORY OF LIABILITY, WHETHER IN CONTRACT, STRICT LIABILITY, OR TORT (INCLUDING NEGLIGENCE OR OTHERWISE) ARISING IN ANY WAY OUT OF THE USE OF THIS SOFTWARE, EVEN IF ADVISED OF THE POSSIBILITY OF SUCH DAMAGE.
