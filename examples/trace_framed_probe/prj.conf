## CMakeLists.txt
```
# SPDX-License-Identifier: Apache-2.0
cmake_minimum_required(VERSION 3.20.5)
find_package(Zephyr REQUIRED HINTS $ENV{ZEPHYR_BASE})
project(zephyr_framed_trace_probe)
target_sources(app PRIVATE src/main.c)
```

## prj.conf
```kconfig
# SPDX-License-Identifier: Apache-2.0
# Build probe only, compiled against explicit pinned Zephyr 4.4 backend.
# The CI build script supplies which ONE of ZEW_RAM / ZEW_RTT is enabled,
# plus exact prebuild contract hashes. NEVER silently default to RTT.
CONFIG_TRACING=y
CONFIG_TRACING_CTF=y
CONFIG_TRACING_CTF_TIMESTAMP=y
CONFIG_TRACING_ASYNC=y
CONFIG_THREAD_NAME=y
CONFIG_TRACING_BUFFER_SIZE=2048
CONFIG_TRACING_THREAD_STACK_SIZE=2048
CONFIG_TRACING_THREAD_WAIT_THRESHOLD=10
CONFIG_MAIN_STACK_SIZE=1024

# TEST / CI ONLY. MSPM0 has no verified hardware entropy in this matrix.
# A timer-based marker is NOT random/unique enough for live qualification.
CONFIG_TEST_RANDOM_GENERATOR=y
CONFIG_TIMER_RANDOM_GENERATOR=y
```

## src/main.c
```c
/* SPDX-License-Identifier: Apache-2.0 */
/*
 * Vendor-neutral, opt-in Zephyr 4.4 trace lifecycle build probe.
 * It performs no peripheral/flash IO, no probe commands and no RTT setup.
 * Runs on MSPM0, STM32, and other explicitly qualified !SMP Zephyr boards.
 */
#include <zephyr/kernel.h>
#include <stdint.h>

extern int zew_trace_stop_request(void);

volatile int zew_trace_stop_result = -1000;
volatile uint32_t zew_trace_probe_iterations;

static void worker(void *a, void *b, void *c)
{
    ARG_UNUSED(a);
    ARG_UNUSED(b);
    ARG_UNUSED(c);
    for (unsigned i = 0; i < 6U; ++i) {
        zew_trace_probe_iterations++;
        k_msleep(5);
    }
}
K_THREAD_DEFINE(zew_trace_worker_id, 768, worker,
                NULL, NULL, NULL, 5, 0, 0);

int main(void)
{
    /* Let the trace thread drain bounded scheduler events. */
    k_msleep(150);
    zew_trace_stop_result = zew_trace_stop_request();
    /* Stay alive for the async tracing thread to append END. */
    while (true) {
        k_msleep(1000);
    }
}
```
