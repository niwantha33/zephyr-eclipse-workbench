## CMakeLists.txt
```
# SPDX-License-Identifier: Apache-2.0
cmake_minimum_required(VERSION 3.20.5)
find_package(Zephyr REQUIRED HINTS $ENV{ZEPHYR_BASE})
project(gpio_usage_demo)
target_sources(app PRIVATE src/main.c)
```

## Kconfig
```
# SPDX-License-Identifier: Apache-2.0
mainmenu "GPIO usage example"

config GPIO_USAGE_DEMO_EXTRA_OUTPUT
    bool "Also configure MSPM0 GPIO A logical index 15"
    default n
    help
      Disabled by default. Enable only after checking the board schematic,
      package, attached circuit and pin ownership. This actively drives PA15.
      The GPIO A controller must have the exact gpioa node label.

source "Kconfig.zephyr"
```

## prj.conf
```kconfig
# SPDX-License-Identifier: Apache-2.0
CONFIG_GPIO=y
CONFIG_DEBUG_THREAD_INFO=y
CONFIG_DEBUG_OPTIMIZATIONS=y
CONFIG_ASSERT=y
```

## src/main.c
```c
/* SPDX-License-Identifier: Apache-2.0 */
#include <errno.h>
#include <zephyr/kernel.h>
#include <zephyr/drivers/gpio.h>

#define LED0_NODE DT_ALIAS(led0)
#if !DT_NODE_HAS_STATUS(LED0_NODE, okay)
#error "This example requires an enabled led0 alias in the selected board Devicetree"
#endif

static const struct gpio_dt_spec led = GPIO_DT_SPEC_GET(LED0_NODE, gpios);

int main(void)
{
    if (!gpio_is_ready_dt(&led)) {
        return -ENODEV;
    }
    int err = gpio_pin_configure_dt(&led, GPIO_OUTPUT_INACTIVE);
    if (err < 0) {
        return err;
    }

#if defined(CONFIG_GPIO_USAGE_DEMO_EXTRA_OUTPUT)
    /* Opt-in only: verify the physical circuit before driving GPIO A index 15. */
    const struct device *gpio_dev = DEVICE_DT_GET(DT_NODELABEL(gpioa));
    if (!device_is_ready(gpio_dev)) {
        return -ENODEV;
    }
    err = gpio_pin_configure(gpio_dev, 15, GPIO_OUTPUT_INACTIVE);
    if (err < 0) {
        return err;
    }
#endif

    while (1) {
        err = gpio_pin_toggle_dt(&led);
        if (err < 0) {
            return err;
        }
        k_msleep(500);
    }
}
```
